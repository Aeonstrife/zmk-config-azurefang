## config/boards/shields/azurefang/Kconfig.defconfig
```kconfig
if SHIELD_AZUREFANG

config ZMK_KEYBOARD_NAME
    default "azurefang"

config LED
    default y

config CONFIG_ZMK_SLEEP
    default y

config AZUREFANG_BATTERY_BLINK_MS
    int "Duration of battery level blink in ms"
    default 2000

config AZUREFANG_OUTPUT_BLINK_MS
    int "Duration of BLE connection status blink in ms"
    default 1000

config AZUREFANG_INTERVAL_MS
    int "Minimum wait duration between two blinks in ms"
    default 500

config AZUREFANG_BATTERY_LEVEL_HIGH
    int "High battery level percentage"
    default 80

config AZUREFANG_BATTERY_LEVEL_LOW
    int "Low battery level percentage"
    default 20

config AZUREFANG_BATTERY_LEVEL_CRITICAL
    int "Critical battery level percentage"
    default 5

endif
```
